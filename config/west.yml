## config/west.yml
```yaml
manifest:
  remotes:
    - name: aroum
      url-base: https://github.com/aroum
    - name: sqdbruh
      url-base: https://github.com/sqdbruh
  projects:
    - name: zmk
      remote: sqdbruh
      revision: main
      import: app/west.yml
  self:
    path: config
```
